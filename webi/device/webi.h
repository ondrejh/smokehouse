#ifndef __WEBI_H__
#define __WEBI_H__

const char *index_name PROGMEM = "/index.html";
const char *index_html PROGMEM = "\
<!DOCTYPE html>\n\
<html lang=\"cz\">\n\
  <head>\n\
    <meta charset=\"utf-8\">\n\
    <title>IoT Teploměr</title>\n\
    <link rel=\"stylesheet\" href=\"style.css\">\n\
    <script src=\"script.js\"></script>\n\
  </head>\n\
  <body onload=\"load()\">\n\
    <h1 id=\"capt\">IoT Teploměr</h1>\n\
    <div class=\"cTemp\">\n\
      Teplota 1: <span id=\"t1\">..</span>\n\
    </div>\n\
    <div class=\"cTemp\">\n\
      Teplota 2: <span id=\"t2\">..</span>\n\
    </div>\n\
    <div>\n\
      <a id=\"wifi\" href=\"config.html\">WiFi</a>\n\
      <a id=\"server\" href=\"config.html\">Server</a>\n\
    </div>\n\
        <script>\n\
          function load() {\n\
                      reload();\n\
                      fetch(\"config.json\", {cache: \"no-store\"})\n\
                        .then((response) => response.json())\n\
                        .then((json) => {\n\
                                    if (json[\"server\"])\n\
                                      document.getElementById(\"server\").href = json[\"url\"] + \"?id=\" + json[\"idstr\"] + \"&key=\" + json[\"key\"];\n\
                                  });\n\
                    }\n\
\n\
          function reload() {\n\
                      fetch(\"data.json\", {cache: \"no-store\"})\n\
                        .then((response) => response.json())\n\
                        .then((json) => {\n\
                                    //console.log(json);\n\
                                    document.getElementById(\"t1\").innerHTML = json[\"data\"][0] + \"&#8451\";\n\
                                    document.getElementById(\"t2\").innerHTML = json[\"data\"][1] + \"&#8451\";\n\
				    document.getElementById(\"capt\").innerHTML = json[\"caption\"];\n\
				    document.title = json[\"caption\"];\n\
                                  });\n\
                      setTimeout(reload, 5000);\n\
                    }\n\
        </script>\n\
  </body>\n\
</html>\n\
";

const char *config_name PROGMEM = "/config.html";
const char *config_html PROGMEM = "\
<!DOCTYPE html>\n\
<html lang=\"cz\">\n\
  <head>\n\
    <meta charset=\"utf-8\">\n\
    <title>Settings</title>\n\
    <link rel=\"stylesheet\" href=\"style.css\">\n\
    <script src=\"script.js\"></script>\n\
  </head>\n\
  <body onload=\"reload()\">\n\
    <div class=\"overlay\" id=\"overlay\" hidden>\n\
      <div class=\"confirm-box\">\n\
        <div onclick=\"closeConfirmBox()\" class=\"close\">&#10006;</div>\n\
        <h2>Víš jistě co děláš ?!?</h2>\n\
        <p id=\"question\">...</p>\n\
        <p id=\"hint\">...</p>\n\
        <button onclick=\"isConfirm(true)\">Ano</button>\n\
        <button onclick=\"isConfirm(false)\">Ne</button>\n\
      </div>\n\
    </div>\n\
\n\
    <h1>Nastavení</h1>\n\
    <h2>Titulek</h2>\n\
    <form action=\"\" method=\"post\" class=\"cSettings\">\n\
	    <div class=\"cSettings\">\n\
		    <label for=\"capt\">Titulek: </label>\n\
		    <input type=\"text\" name=\"capt\" id=\"capt\" value=\"IoT Teploměr\">\n\
	    </div>\n\
    </form>\n\
    <button onclick=\"saveCaption()\">Uložit</button>\n\
    <h2>WiFi<span id=\"wifi\"></span></h2>\n\
    <div>\n\
    <form action=\"\" method=\"post\" class=\"cSettings\">\n\
      <div class=\"cSettings\">\n\
        <label for=\"ssid\">SSID sítě: </label>\n\
        <input type=\"text\" name=\"ssid\" id=\"ssid\" required>\n\
      </div>\n\
      <div class=\"cSettings\">\n\
        <label for=\"pwd\">Heslo: </label>\n\
        <input type=\"password\" name=\"pwd\" id=\"pwd\" required>\n\
      </div>\n\
    </form>\n\
    <button onclick=\"askNetwork()\">Potvrdit</button>\n\
    </div>\n\
\n\
    <h2>Server<span id=\"server\"></span></h2>\n\
    <div>\n\
    <form action=\"\" method=\"post\" class=\"cSettings\">\n\
      <div class=\"cSettings\">\n\
        <label for=\"url\">URL serveru: </label>\n\
        <input type=\"text\" name=\"url\" id=\"url\" required>\n\
      </div>\n\
      <div class=\"cSettings\">\n\
        <label for=\"key\">Klíč: </label>\n\
        <input type=\"password\" name=\"key\" id=\"key\" required>\n\
      </div>\n\
    </form>\n\
    <button onclick=\"askServer()\">Potvrdit</button>\n\
    </div>\n\
\n\
    <button onclick=\"reload()\">Vrátit změny</button>\n\
    <div>\n\
      <a href=\"index.html\">Zpět</a>\n\
    </div>\n\
\n\
        <script>\n\
          var d = {};\n\
\n\
          function reload() {\n\
                      fetch(\"config.json\", {cache: \"no-store\"})\n\
                        .then((response) => response.json())\n\
                        .then((json) => {\n\
                                    //console.log(json);\n\
                                    let key = document.getElementById(\"key\");\n\
                                    let url = document.getElementById(\"url\");\n\
                                    key.value = \"\";\n\
                                    url.value = json[\"url\"];\n\
                                    if (json[\"url\"] != \"\") {\n\
                                                key.placeholder = \"********\";\n\
                                              }\n\
                                    else {\n\
                                                key.placeholder = \"123456\";\n\
                                                url.placeholder = \"http://www.mujserver.cz/datain.php\";\n\
                                              }\n\
                                    let ssid = document.getElementById(\"ssid\");\n\
                                    let pwd = document.getElementById(\"pwd\");\n\
                                    pwd.value = \"\";\n\
                                    ssid.value = json[\"ssid\"];\n\
                                    if (json[\"ssid\"] != \"\") {\n\
                                                pwd.placeholder = \"********\";\n\
                                              }\n\
                                    else {\n\
                                                pwd.placeholder = \"123456\";\n\
                                                ssid.placeholder = \"uNasDoma\";\n\
                                              }\n\
                                    if (json[\"wifi\"])\n\
                                      document.getElementById(\"wifi\").innerText = \" OK\";\n\
                                    if (json[\"server\"])\n\
                                      document.getElementById(\"server\").innerText = \" OK\";\n\
				    document.getElementById(\"capt\").value = json[\"caption\"]\n\
                                  });\n\
                    }\n\
\n\
          function showConfirmBox() {\n\
                      document.getElementById(\"overlay\").hidden = false;\n\
                    }\n\
          function closeConfirmBox() {\n\
                      document.getElementById(\"overlay\").hidden = true;\n\
                    }\n\
\n\
          function isConfirm(answer) {\n\
                      if (answer) {\n\
				  let body =\"\";\n\
				  let first = true;\n\
			          for (const property in d) {\n\
				        if (!first) {\n\
					 	body += \"&\";\n\
					}\n\
					first = false;\n\
							  body += `${property}=${d[property]}`;\n\
						  };\n\
				  console.log(body);\n\
                                  fetch(\"set.php\", {\n\
                                              method: 'POST',\n\
                                              headers: {\n\
                                                          'Accept': '*/*',\n\
                                                          'Content-Type': 'application/x-www-form-urlencoded'\n\
                                                        },\n\
                                              body: body\n\
                                            });\n\
                                  setTimeout(reload, 500);\n\
                                }\n\
                      closeConfirmBox();\n\
                    }\n\
\n\
	function saveCaption() {\n\
				let capt = document.getElementById(\"capt\").value;\n\
				d = {\"capt\": capt};\n\
				isConfirm(true);\n\
			}\n\
\n\
          function askNetwork() {\n\
                      document.getElementById(\"question\").innerText = \"Chceš skutečně měnit nastavení WiFi ?\";\n\
                      document.getElementById(\"hint\").innerHTML =\n\
                        \"Nastavení WiFi umožňuje připojit se k místní síti.</br>\" +\n\
                        \"Pokud je toto nastavení chybné, nebo není WiFi síť k dispozici, nemůže zařízení odesílat data na internet.</br>\" +\n\
                        \"V takovém přípaďě přejde zařízení do režimu AP (vytvoření vlastní sítě), aby bylo možné nastavení opravit.\";\n\
                      let ssid = document.getElementById(\"ssid\").value;\n\
                      let pwd = document.getElementById(\"pwd\").value;\n\
                      d = {\"ssid\":ssid, \"pwd\":pwd}\n\
                      showConfirmBox();\n\
                    }\n\
          function askServer() {\n\
                      document.getElementById(\"question\").innerText = \"Chceš skutečně měnit nastavení serveru ?\";\n\
                      document.getElementById(\"hint\").innerHTML =\n\
                        \"Nastavení vzdáleného serveru udává, kam se odesílají data ze zařízení.</br>\" +\n\
                        \"Pokud je toto nastavení chybné, nebo nemá zařízení přístup k internetu, \" +\n\
                        \"měření stále funguje, ale je přístupné pouze z lokální sítě.</br> \" +\n\
                        \"Nastavení se dělá pouze jednou, po registraci zařízení na serveru.\";\n\
                      let url = document.getElementById(\"url\").value;\n\
                      let key = document.getElementById(\"key\").value;\n\
                      d = {\"url\": url, \"key\": key};\n\
                      showConfirmBox();\n\
                    }\n\
        </script>\n\
\n\
  </body>\n\
</html>\n\
";

#define STYLE_LEN 328
const char *style_name PROGMEM = "/style.css";
const char style_bin[STYLE_LEN] PROGMEM = {
0x68, 0x74, 0x6D, 0x6C, 0x2C, 0x20, 0x62, 0x6F, 0x64, 0x79, 0x20, 0x7B, 0x0A, 0x20, 0x20, 0x68,
0x65, 0x69, 0x67, 0x68, 0x74, 0x3A, 0x20, 0x31, 0x30, 0x30, 0x25, 0x3B, 0x0A, 0x7D, 0x0A, 0x2E,
0x6F, 0x76, 0x65, 0x72, 0x6C, 0x61, 0x79, 0x20, 0x7B, 0x0A, 0x20, 0x20, 0x70, 0x6F, 0x73, 0x69,
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0x74, 0x65, 0x72, 0x3B, 0x0A, 0x7D, 0x0A, 0x00};

#define FAVICON_LEN 1150
const char *favicon_name PROGMEM = "/favicon.ico";
const char favicon_bin[FAVICON_LEN] PROGMEM = {
0x00, 0x00, 0x01, 0x00, 0x01, 0x00, 0x10, 0x10, 0x00, 0x00, 0x01, 0x00, 0x20, 0x00, 0x68, 0x04,
0x00, 0x00, 0x16, 0x00, 0x00, 0x00, 0x28, 0x00, 0x00, 0x00, 0x10, 0x00, 0x00, 0x00, 0x20, 0x00,
0x00, 0x00, 0x01, 0x00, 0x20, 0x00, 0x00, 0x00, 0x00, 0x00, 0x00, 0x04, 0x00, 0x00, 0x00, 0x00,
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0x00, 0x00, 0xF0, 0x0F, 0x00, 0x00, 0xF0, 0x0F, 0x00, 0x00, 0xF8, 0x1F, 0x00, 0x00};

#define SCRIPT_LEN 0
const char *script_name PROGMEM = "/script.js";
const char script_bin[SCRIPT_LEN] PROGMEM = {
};

#endif __WEBI_H__

#ifndef __WEBI_H__
#define __WEBI_H__

const char *index_name PROGMEM = "/index.html";
const char *index_html PROGMEM = "\
<!DOCTYPE html>\n\
<html lang=\"cz\">\n\
  <head>\n\
    <meta charset=\"utf-8\">\n\
    <title>IoT Teploměr</title>\n\
    <style>\n\
			@import url(https://fonts.googleapis.com/css?family=Open+Sans:700,300);\n\
			html {\n\
				margin:    0 auto;\n\
    		max-width: 200px;//700px;\n\
			}\n\
			.shadow {\n\
				-webkit-filter: drop-shadow( 3px 3px 2px rgba(0, 0, 0, .7));\n\
				filter: drop-shadow( 3px 3px 2px rgba(0, 0, 0, .7));\n\
			}\n\
			text {\n\
				fill: #556B2F;\n\
				font-family: 'Open Sans', Helvetica, sans-serif;\n\
				-webkit-font-smoothing: antialiased;\n\
				text-shadow: 3px 3px 5px rgba(0, 0, 0, .7);\n\
			}\n\
		</style>\n\
  </head>\n\
  <body onload=\"load()\">\n\
    <svg viewBox=\"0 0 200 200\">\n\
      <defs>\n\
        <linearGradient id=\"grad1\" x1=\"0%\" y1=\"0%\" x2=\"100%\" y2=\"0%\">\n\
          <stop offset=\"0%\" style=\"stop-color:rgb(50,50,255);stop-opacity:1\" />\n\
          <stop offset=\"100%\" style=\"stop-color:rgb(255,50,50);stop-opacity:1\" />\n\
        </linearGradient>\n\
      </defs>\n\
      <circle cx=\"100\" cy=\"100\" r=\"93\" fill=\"url(#grad1)\" />\n\
      <polygon points=\"0,200 0,150 100,100 200,150 200,200\" style=\"fill:white;stroke:white;stroke-width:0\" />\n\
      <circle class=\"shadow\" cx=\"100\" cy=\"100\" r=\"70\" fill=\"GhostWhite\" />\n\
      <text id=\"temp2\" x=\"50%\" y=\"33%\" font-size=\"1.5em\" dominant-baseline=\"middle\" text-anchor=\"middle\"></text>\n\
      <text id=\"temp1\" x=\"50%\" y=\"50%\" font-size=\"2.5em\" dominant-baseline=\"middle\" text-anchor=\"middle\"></text>\n\
      <text id=\"caption\" x=\"50%\" y=\"66%\" font-size=\"1.2em\" dominant-baseline=\"middle\" text-anchor=\"middle\">No data</text>\n\
      <circle class=\"shadow\" cx=\"100\" cy=\"100\" r=\"97\" fill=\"rgba(0,0,0,0.03)\" />\n\
      <line id=\"pointer\" class=\"shadow\" x1=\"100\" y1=\"5\" x2=\"100\" y2=\"40\" style=\"stroke:rgb(128,50,128);stroke-width:2\" />\n\
      Sorry, your browser does not support inline SVG.\n\
    </svg>\n\
\n\
    <div>\n\
      <a id=\"wifi\" href=\"config.html\">WiFi</a>\n\
      <a id=\"server\" href=\"config.html\">Server</a>\n\
    </div>\n\
\n\
<script>\n\
	function load() {\n\
		reload();\n\
		fetch(\"config.json\", {cache: \"no-store\"})\n\
			.then((response) => response.json())\n\
			.then((json) => {\n\
				document.getElementById(\"server\").innerHTML = json[\"server\"] ? \"Server OK\" : \"Server ERROR\";\n\
				document.getElementById(\"wifi\").innerHTML = json[\"wifi\"] ? \"Wifi OK\" : \"Wifi ERROR\";\n\
			});\n\
	}\n\
\n\
	function reload() {\n\
		fetch(\"data.json\", {cache: \"no-store\"})\n\
   		.then((response) => response.json())\n\
   		.then((json) => {\n\
   			//console.log(json);\n\
				let t1 = parseFloat(json[\"data\"][0]);\n\
				let t2 = parseFloat(json[\"data\"][1]);\n\
				let caption = json[\"caption\"];\n\
   			document.getElementById(\"temp1\").innerHTML = t1.toFixed(1) + '&deg';\n\
   			document.getElementById(\"temp2\").innerHTML = t2.toFixed(1) + '&deg';\n\
   			document.getElementById(\"caption\").innerHTML = caption;\n\
\n\
				let tmin = 0.0;\n\
				let tmax = 150.0;\n\
				let pi32 = Math.PI/3*2;\n\
				let pi34 = pi32*2;\n\
				let angle = -pi32 + t1 / (tmax - tmin) * pi34;\n\
				let sx = Math.sin(angle);\n\
				let cy = Math.cos(angle);\n\
				let x1 = 100 + sx * 60;\n\
				let x2 = 100 + sx * 95;\n\
				let y1 = 100 - cy * 60;\n\
				let y2 = 100 - cy * 95;\n\
				//console.log(angle, x1, y1, x2, y2);\n\
				document.getElementById(\"pointer\").setAttribute(\"x1\", x1);\n\
				document.getElementById(\"pointer\").setAttribute(\"y1\", y1);\n\
				document.getElementById(\"pointer\").setAttribute(\"x2\", x2);\n\
				document.getElementById(\"pointer\").setAttribute(\"y2\", y2);\n\
   		});\n\
   		setTimeout(reload, 2500);\n\
   }\n\
</script>\n\
\n\
  </body>\n\
</html>\n\
";

const char *config_name PROGMEM = "/config.html";
const char *config_html PROGMEM = "\
<!DOCTYPE html>\n\
<html lang=\"cz\">\n\
  <head>\n\
    <meta charset=\"utf-8\">\n\
    <title>Settings</title>\n\
    <!--<link rel=\"stylesheet\" href=\"style.css\">\n\
    <script src=\"script.js\"></script>-->\n\
  </head>\n\
  <body onload=\"reload()\">\n\
    <div class=\"overlay\" id=\"overlay\" hidden>\n\
      <div class=\"confirm-box\">\n\
        <div onclick=\"closeConfirmBox()\" class=\"close\">&#10006;</div>\n\
        <h2>Víš jistě co děláš ?!?</h2>\n\
        <p id=\"question\">...</p>\n\
        <p id=\"hint\">...</p>\n\
        <button onclick=\"isConfirm(true)\">Ano</button>\n\
        <button onclick=\"isConfirm(false)\">Ne</button>\n\
      </div>\n\
    </div>\n\
\n\
    <h1>Nastavení</h1>\n\
\n\
    <h2>Titulek</h2>\n\
    <form action=\"\" method=\"post\" class=\"cSettings\">\n\
	    <div class=\"cSettings\">\n\
		    <label for=\"capt\">Titulek: </label>\n\
		    <input type=\"text\" name=\"capt\" id=\"capt\" value=\"IoT Teploměr\">\n\
	    </div>\n\
    </form>\n\
    <button onclick=\"saveCaption()\">Uložit</button>\n\
\n\
    <h2>WiFi<span id=\"wifi\"></span></h2>\n\
    <form action=\"\" method=\"post\" class=\"cSettings\">\n\
      <div class=\"cSettings\">\n\
        <label for=\"ssid\">SSID sítě: </label>\n\
        <input type=\"text\" name=\"ssid\" id=\"ssid\" required>\n\
      </div>\n\
      <div class=\"cSettings\">\n\
        <label for=\"pwd\">Heslo: </label>\n\
        <input type=\"password\" name=\"pwd\" id=\"pwd\" required>\n\
      </div>\n\
    </form>\n\
    <button onclick=\"askNetwork()\">Potvrdit</button>\n\
\n\
    <h2>MQTT<span id=\"mqtt\"></span></h2>\n\
    <form action=\"\" method=\"post\" class=\"cSettings\">\n\
      <div class=\"cSettings\">\n\
        <label for=\"mqtt_ip\">IP adresa MQTT serveru: </label>\n\
        <input type=\"text\" name=\"mqtt_ip\" id=\"mqtt_ip\" required>\n\
      </div>\n\
      <div class=\"cSettings\">\n\
        <label for=\"mqtt_topic\">Topic: </label>\n\
        <input type=\"text\" name=\"mqtt_topic\" id=\"mqtt_topic\" required>\n\
      </div>\n\
      <div class=\"cSettings\">\n\
        <label for=\"mqtt_usr\">Uživatel: </label>\n\
        <input type=\"text\" name=\"mqtt_usr\" id=\"mqtt_usr\" required>\n\
      </div>\n\
      <div class=\"cSettings\">\n\
        <label for=\"mqtt_pwd\">Heslo: </label>\n\
        <input type=\"password\" name=\"mqtt_pwd\" id=\"mqtt_pwd\" required>\n\
      </div>\n\
    </form>\n\
    <button onclick=\"askMqtt()\">Potvrdit</button>\n\
\n\
    <h2>Server<span id=\"server\"></span></h2>\n\
    <form action=\"\" method=\"post\" class=\"cSettings\">\n\
      <div class=\"cSettings\">\n\
        <label for=\"url\">URL serveru: </label>\n\
        <input type=\"text\" name=\"url\" id=\"url\" required>\n\
      </div>\n\
      <div class=\"cSettings\">\n\
        <label for=\"key\">Klíč: </label>\n\
        <input type=\"password\" name=\"key\" id=\"key\" required>\n\
      </div>\n\
    </form>\n\
    <button onclick=\"askServer()\">Potvrdit</button>\n\
\n\
    <button onclick=\"reload()\">Vrátit změny</button>\n\
    <div>\n\
      <a href=\"index.html\">Zpět</a>\n\
    </div>\n\
\n\
    <script>\n\
      var d = {};\n\
\n\
      function reload() {\n\
        fetch(\"config.json\", {cache: \"no-store\"})\n\
        .then((response) => response.json())\n\
        .then((json) => {\n\
          //console.log(json);\n\
          let key = document.getElementById(\"key\");\n\
          let url = document.getElementById(\"url\");\n\
          key.value = \"\";\n\
          url.value = json[\"url\"];\n\
          if (json[\"url\"] != \"\") {\n\
                      key.placeholder = \"********\";\n\
                    }\n\
          else {\n\
                      key.placeholder = \"123456\";\n\
                      url.placeholder = \"http://www.mujserver.cz/datain.php\";\n\
                    }\n\
          let ssid = document.getElementById(\"ssid\");\n\
          let pwd = document.getElementById(\"pwd\");\n\
          pwd.value = \"\";\n\
          ssid.value = json[\"ssid\"];\n\
          if (json[\"ssid\"] != \"\") {\n\
            pwd.placeholder = \"********\";\n\
          }\n\
          else {\n\
            pwd.placeholder = \"123456\";\n\
            ssid.placeholder = \"uNasDoma\";\n\
          }\n\
\n\
          if (json[\"wifi\"])\n\
            document.getElementById(\"wifi\").innerText = \" OK\";\n\
          if (json[\"server\"])\n\
            document.getElementById(\"server\").innerText = \" OK\";\n\
          if (json[\"mqtt\"])\n\
            document.getElementById(\"mqtt\").innerText = \" OK\";\n\
\n\
          let mqtt_ip = document.getElementById(\"mqtt_ip\");\n\
          let mqtt_topic = document.getElementById(\"mqtt_topic\");\n\
          let mqtt_usr = document.getElementById(\"mqtt_usr\");\n\
          let mqtt_pwd = document.getElementById(\"mqtt_pwd\");\n\
          if (\"mqtt_ip\" in json) {\n\
            mqtt_ip.value = json[\"mqtt_ip\"];\n\
          }\n\
          else {\n\
            mqtt_ip.placeholder = \"192.168.42.123\"\n\
          }\n\
          if (\"mqtt_topic\" in json) {\n\
            mqtt_topic.value = json[\"mqtt_topic\"];\n\
          }\n\
          else {\n\
            mqtt_topic.placeholder = \"/home/my_temp\";\n\
          }\n\
\n\
          mqtt_pwd.value = \"\";\n\
          if (\"mqtt_usr\" in json) {\n\
            mqtt_usr.value = json[\"mqtt_usr\"];\n\
            mqtt_pwd.placeholder = \"********\";\n\
          }\n\
          else {\n\
            mqtt_pwd.placeholder = \"mqttPassword\";\n\
            mqtt_usr.placeholder = \"mqttUser\";\n\
          }\n\
\n\
          let caption = document.getElementById(\"capt\")\n\
          if (\"caption\" in json) {\n\
            caption.value = json[\"caption\"];\n\
          }\n\
          else {\n\
            caption.placeholder = \"Name Me\";\n\
          }\n\
        });\n\
      }\n\
\n\
      function showConfirmBox() {\n\
        document.getElementById(\"overlay\").hidden = false;\n\
      }\n\
      function closeConfirmBox() {\n\
        document.getElementById(\"overlay\").hidden = true;\n\
      }\n\
\n\
      function isConfirm(answer) {\n\
        if (answer) {\n\
          let body =\"\";\n\
          let first = true;\n\
          for (const property in d) {\n\
            if (!first) {\n\
              body += \"&\";\n\
            }\n\
            first = false;\n\
            body += `${property}=${d[property]}`;\n\
          };\n\
          console.log(body);\n\
          fetch(\"set.php\", {\n\
            method: 'POST',\n\
            headers: {\n\
              'Accept': '*/*',\n\
              'Content-Type': 'application/x-www-form-urlencoded'\n\
            },\n\
            body: body\n\
          });\n\
          setTimeout(reload, 500);\n\
        }\n\
        closeConfirmBox();\n\
      }\n\
\n\
      function saveCaption() {\n\
        let capt = document.getElementById(\"capt\").value;\n\
        d = {\"capt\": capt};\n\
        isConfirm(true);\n\
      }\n\
\n\
      function askNetwork() {\n\
        document.getElementById(\"question\").innerText = \"Chceš skutečně měnit nastavení WiFi ?\";\n\
        document.getElementById(\"hint\").innerHTML =\n\
          \"Nastavení WiFi umožňuje připojit se k místní síti.</br>\" +\n\
          \"Pokud je toto nastavení chybné, nebo není WiFi síť k dispozici, nemůže zařízení odesílat data na internet.</br>\" +\n\
          \"V takovém přípaďě přejde zařízení do režimu AP (vytvoření vlastní sítě), aby bylo možné nastavení opravit.\";\n\
        let ssid = document.getElementById(\"ssid\").value;\n\
        let pwd = document.getElementById(\"pwd\").value;\n\
        d = {\"ssid\":ssid, \"pwd\":pwd}\n\
        showConfirmBox();\n\
      }\n\
\n\
      function askMqtt() {\n\
        document.getElementById(\"question\").innerText = \"Chceš skutečně měnit nastavení MQTT ?\";\n\
        document.getElementById(\"hint\").innerHTML = \"Nastavení MQTT umožňuje odesílat hodnoty na server.\"\n\
        let mqtt_ip = document.getElementById(\"mqtt_ip\").value;\n\
        let mqtt_topic = document.getElementById(\"mqtt_topic\").value;\n\
        let mqtt_usr = document.getElementById(\"mqtt_usr\").value;\n\
        let mqtt_pwd = document.getElementById(\"mqtt_pwd\").value;\n\
        d = {\"mqtt_ip\":mqtt_ip, \"mqtt_topic\":mqtt_topic, \"mqtt_usr\":mqtt_usr, \"mqtt_pwd\":mqtt_pwd}\n\
        showConfirmBox();\n\
      }\n\
\n\
      function askServer() {\n\
        document.getElementById(\"question\").innerText = \"Chceš skutečně měnit nastavení serveru ?\";\n\
        document.getElementById(\"hint\").innerHTML =\n\
          \"Nastavení vzdáleného serveru udává, kam se odesílají data ze zařízení.</br>\" +\n\
          \"Pokud je toto nastavení chybné, nebo nemá zařízení přístup k internetu, \" +\n\
          \"měření stále funguje, ale je přístupné pouze z lokální sítě.</br> \" +\n\
          \"Nastavení se dělá pouze jednou, po registraci zařízení na serveru.\";\n\
        let url = document.getElementById(\"url\").value;\n\
        let key = document.getElementById(\"key\").value;\n\
        d = {\"url\": url, \"key\": key};\n\
        showConfirmBox();\n\
      }\n\
    </script>\n\
  </body>\n\
</html>\n\
";

#define FAVICON_LEN 4286
const char *favicon_name PROGMEM = "/favicon.ico";
const char favicon_bin[FAVICON_LEN] PROGMEM = {
0x00, 0x00, 0x01, 0x00, 0x01, 0x00, 0x20, 0x20, 0x00, 0x00, 0x01, 0x00, 0x20, 0x00, 0xA8, 0x10,
0x00, 0x00, 0x16, 0x00, 0x00, 0x00, 0x28, 0x00, 0x00, 0x00, 0x20, 0x00, 0x00, 0x00, 0x40, 0x00,
0x00, 0x00, 0x01, 0x00, 0x20, 0x00, 0x00, 0x00, 0x00, 0x00, 0x00, 0x00, 0x00, 0x00, 0x00, 0x00,
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0x00, 0x1F, 0xFC, 0x00, 0x00, 0x3F, 0xFF, 0x00, 0x00, 0xFF, 0xFF, 0xC0, 0x03, 0xFF};

#endif __WEBI_H__
